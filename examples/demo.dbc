VERSION "OCA public demonstration database"

NS_ :

BS_:

BU_: DemoNode

BO_ 257 DemoStatus: 8 DemoNode
 SG_ Speed : 0|16@1+ (0.1,0) [0|6553.5] "km/h" DemoNode
 SG_ Temperature : 16|8@1+ (1,-40) [-40|215] "degC" DemoNode

CM_ BO_ 257 "Synthetic public data for Open CAN Analyzer demonstrations.";
